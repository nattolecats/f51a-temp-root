## source/kernel/msm-4.19/arch/arm64/configs/vendor/fjdev-perf_defconfig
```kconfig
#----------------------------------------------------------------------------
# (C) 2021 FCNT LIMITED
#----------------------------------------------------------------------------
CONFIG_LOCALVERSION=""
# CONFIG_CORESIGHT is not set
# CONFIG_LOCKUP_DETECTOR is not set
# CONFIG_DEBUG_MUTEXES is not set
# CONFIG_DEBUG_ATOMIC_SLEEP is not set
# CONFIG_DEBUG_MEMORY_INIT is not set
CONFIG_PANIC_ON_DATA_CORRUPTION=y
CONFIG_PANIC_ON_RT_THROTTLING=y
CONFIG_LOG_BUF_SHIFT=19
CONFIG_SERIAL_MSM_GENI_CONSOLE=y
CONFIG_PANIC_ON_OOPS=y
CONFIG_IP_MULTICAST=y
CONFIG_SECURITY_PATH=y
CONFIG_SECURITY_FJSEC=y
CONFIG_INET_XFRM_MODE_TRANSPORT=y
CONFIG_INET_XFRM_MODE_TUNNEL=y
CONFIG_CRYPTO_SHA256=y
CONFIG_NETFILTER_XT_MATCH_TCPMSS=y
CONFIG_NLS_UTF8=y
```

## source/kernel/msm-4.19/arch/arm64/configs/vendor/fjdev_defconfig
```kconfig
#----------------------------------------------------------------------------
# (C) 2021 FCNT LIMITED
#----------------------------------------------------------------------------
CONFIG_LOCALVERSION="-def"
CONFIG_CGROUP_DEBUG=y
CONFIG_SLUB_DEBUG=y
CONFIG_SOFTLOCKUP_DETECTOR=y
CONFIG_DEBUG_SPINLOCK=y
CONFIG_DEBUG_MUTEXES=y
CONFIG_DEBUG_ATOMIC_SLEEP=y
CONFIG_DEBUG_MEMORY_INIT=y
CONFIG_FAULT_INJECTION=y
CONFIG_FAULT_INJECTION_DEBUG_FS=y
CONFIG_FAULT_INJECTION_STACKTRACE_FILTER=y
CONFIG_DYNAMIC_DEBUG=y
CONFIG_PANIC_ON_DATA_CORRUPTION=y
CONFIG_PAGE_OWNER=y
CONFIG_PAGE_OWNER_ENABLE_DEFAULT=y
CONFIG_BOOTPARAM_SOFTLOCKUP_PANIC=y
CONFIG_PANIC_ON_RT_THROTTLING=y
CONFIG_BLK_DEV_IO_TRACE=y
CONFIG_LOG_BUF_SHIFT=19
CONFIG_MSM_GLADIATOR_ERP=y
CONFIG_PANIC_ON_GLADIATOR_ERROR=y
CONFIG_MSM_GLADIATOR_HANG_DETECT=y
CONFIG_CORESIGHT_REMOTE_ETM=y
CONFIG_CORESIGHT_REMOTE_ETM_DEFAULT_ENABLE=0
CONFIG_QCOM_RTB=y
CONFIG_QCOM_RTB_SEPARATE_CPUS=y
CONFIG_SERIAL_MSM_GENI_CONSOLE=y
CONFIG_DEBUG_PANIC_ON_OOM=y
CONFIG_PANIC_ON_OOPS=y
CONFIG_IP_MULTICAST=y
CONFIG_SECURITY_PATH=y
CONFIG_SECURITY_FJSEC=y
CONFIG_INET_XFRM_MODE_TRANSPORT=y
CONFIG_INET_XFRM_MODE_TUNNEL=y
CONFIG_CRYPTO_SHA256=y
CONFIG_NETFILTER_XT_MATCH_TCPMSS=y

CONFIG_NLS_UTF8=y
```

## source/kernel/msm-4.19/drivers/nonvolatile/Kconfig
```kconfig
#===============================================================================
# (C) 2021 FCNT LIMITED
#===============================================================================

#
# nonvolatile configuration
#
config NONVOLATILE
	tristate "Nonvolatile data read/write support"
```
